## boards/arm/sofle/Kconfig.board
```kconfig
#
# Copyright (c) 2024 The ZMK Contributors
# SPDX-License-Identifier: MIT
#

config BOARD_SOFLE_LEFT
    bool "sofle left"
    depends on SOC_NRF52840_QIAA


config BOARD_SOFLE_RIGHT
    bool "sofle right"
    depends on SOC_NRF52840_QIAA
```

## config/west.yml
```yaml
manifest:
  remotes:
    - name: zmkfirmware
      url-base: https://github.com/SixPiinGit
    - name: gpeye
      url-base: https://github.com/GPeye
  projects:
    - name: zmk
      remote: zmkfirmware
      revision: main
      import: app/west.yml
    - name: hammerbeam-slideshow
      remote: gpeye
      revision: main 
    - name: zmk-a320-driver
      remote: zmkfirmware
      revision: main 
  self:
    path: boards
```
